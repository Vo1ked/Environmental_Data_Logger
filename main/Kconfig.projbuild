## main/Kconfig.projbuild
```kconfig
menu "Environmental Data Logger"
config EDL_SDA_GPIO
    int "I2C SDA (RTC + OLED)"
    range 0 48
    default 8
config EDL_SCL_GPIO
    int "I2C SCL (RTC + OLED)"
    range 0 48
    default 9
config EDL_MOSI_GPIO
    int "BME280 SPI MOSI / SDI"
    range 0 48
    default 11
config EDL_MISO_GPIO
    int "BME280 SPI MISO / SDO"
    range 0 48
    default 13
config EDL_SCLK_GPIO
    int "BME280 SPI SCLK"
    range 0 48
    default 12
config EDL_CS_GPIO
    int "BME280 SPI CSB"
    range 0 48
    default 10
config EDL_OLED_ADDRESS
    hex "SSD1306 128x64 address"
    range 0x3c 0x3d
    default 0x3c
config EDL_OLED_CONTRAST
    int "OLED contrast (lower value reduces display current)"
    range 0 255
    default 32
config EDL_UART_TX_GPIO
    int "UART1 TX -> USB-TTL RXD"
    range 0 48
    default 17
config EDL_UART_RX_GPIO
    int "UART1 RX <- USB-TTL TXD (3.3 V logic)"
    range 0 48
    default 18
config EDL_INITIAL_UTC
    string "Initial RTC UTC (empty uses build time), YYYY-MM-DDTHH:MM:SSZ"
    default ""
    help
        Applied only to stopped or invalid RTC. Running clocks are preserved.
        Build time is approximate. Use time set to correct UTC after flashing.
config EDL_TIMEZONE
    string "POSIX timezone for OLED (RTC and archive use UTC)"
    default "EET-2EEST,M3.5.0/3,M10.5.0/4"
    help
        Configurable Eastern European display rule. Use UTC0 for UTC display.
endmenu
```

## sdkconfig.defaults
```kconfig
CONFIG_IDF_TARGET="esp32s3"
CONFIG_ESPTOOLPY_FLASHSIZE_2MB=y
CONFIG_PARTITION_TABLE_CUSTOM=y
CONFIG_PARTITION_TABLE_CUSTOM_FILENAME="partitions.csv"
CONFIG_ESP_CONSOLE_SECONDARY_NONE=y
CONFIG_ESP_INT_WDT=y
CONFIG_ESP_TASK_WDT_EN=y
CONFIG_ESP_TASK_WDT_INIT=y
CONFIG_ESP_TASK_WDT_TIMEOUT_S=5
CONFIG_ESP_TASK_WDT_CHECK_IDLE_TASK_CPU0=y
CONFIG_ESP_TASK_WDT_CHECK_IDLE_TASK_CPU1=y
CONFIG_ESP_TASK_WDT_PANIC=y
CONFIG_ESP_SYSTEM_PANIC_PRINT_REBOOT=y
CONFIG_ESP_SYSTEM_PANIC_REBOOT_DELAY_SECONDS=0
```
